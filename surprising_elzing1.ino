#include <Servo.h> // подключаем библиотеку сервопривода

Servo my_servo; // объявляем переменную для сервопривода
String mess; // объявляем переменную для хранения данных из порта

void setup() {
    Serial.begin(9600); // инициализируем последовательное соединение
    pinMode(9, OUTPUT); // назначаем пин со светодиодом на выход
}

void loop() {
    if (Serial.available() > 0) { // если в порт пришли данные, то...
        mess = Serial.readString(); // ... сохраняем их в переменную
        
        if (mess == "open") { // если пришло слово open, то...
            my_servo.attach(8); // инициализируем сервопривод
            my_servo.write(0); // поворачиваем сервопривод на угол 0 градусов
            
            tone(7, 200, 50); // коротко пищим пьезодинамиком
            delay(100); // ждём 100 мс
            tone(7, 400, 50); // коротко пищим пьезодинамиком
            delay(100); // ждём 100 мс
            tone(7, 500, 50); // коротко пищим пьезодинамиком
            delay(100); // ждём 100 мс
            
            my_servo.detach(); // отключаем сервопривод
            digitalWrite(9, LOW); // гасим светодиод на 9-м пине
            Serial.println("Замок открыт"); // посылаем сообщение в порт о том, что замок открыт
        }
        
        if (mess == "lock") { // если пришло слово lock, то...
            my_servo.attach(8); // инициализируем сервопривод
            my_servo.write(180); // поворачиваем сервопривод на угол 180 градусов
            
            tone(7, 200, 50); // коротко пищим пьезодинамиком
            delay(100); // ждём 100 мс
            tone(7, 200, 50); // коротко пищим пьезодинамиком
            delay(100); // ждём 100 мс
            tone(7, 200, 50); // коротко пищим пьезодинамиком
            delay(100); // ждём 100 мс
            
            my_servo.detach(); // отключаем сервопривод
            digitalWrite(9, HIGH); // зажигаем светодиод на 9-м пине
            Serial.println("Замок закрыт"); // посылаем сообщение в порт о том, что замок закрыт
        }
    }
}